/ {
    behaviors {
        mod_morph_esc: behavior_morph {
            compatible = "zmk,behavior-morph";
            bindings = <&kp ESC>, <&kp GRAVE>;
            primary-behavior = <0>;
            alternate-behavior = <(MOD_LSFT)>;
        };
    };
};
